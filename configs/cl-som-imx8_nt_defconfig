## configs/cl-som-imx8_nt_defconfig
```kconfig
CONFIG_ARM=y
CONFIG_ARCH_IMX8M=y
CONFIG_SYS_MALLOC_F_LEN=0x2000
CONFIG_TARGET_COMPULAB_IMX8=y
CONFIG_DEFAULT_DEVICE_TREE="cl-som-imx8"
CONFIG_LOCALVERSION="-cl-som-imx8-1.0"
CONFIG_FIT=y
CONFIG_SPL_LOAD_FIT=y
CONFIG_SYS_EXTRA_OPTIONS="IMX_CONFIG=arch/arm/imx-common/spl_sd.cfg,FB_ADDR=CONFIG_SYS_SDRAM_BASE,BAUDRATE=921600"
CONFIG_USE_BOOTCOMMAND=y
CONFIG_BOOTCOMMAND="globalpage init 0x407E9000; globalpage add ethaddr; usb start; part list mmc ${mmcdev} devplist; for bootpar in ${devplist}; do part type mmc ${mmcdev}:${bootpar} part_type; if test ${part_type} = 1d30adf8-0aef-4d83-b78c-ac719086c709; then if read mmc ${mmcdev}:${bootpar} ${loadaddr} 0 1000; then bootm ${loadaddr}; fi; fi; done;"
CONFIG_IMX_PERSIST_INIT=y
CONFIG_SPL=y
CONFIG_HUSH_PARSER=y
CONFIG_CMD_I2C=y
CONFIG_CMD_GPIO=y
CONFIG_CMD_CACHE=y
CONFIG_CMD_GLOBAL_PAGE=y
CONFIG_CMD_PMIC=y
CONFIG_CMD_REGULATOR=y
CONFIG_CMD_FS_GENERIC=y
CONFIG_OF_CONTROL=y
# CONFIG_BLK is not set
CONFIG_DM_GPIO=y
CONFIG_DM_I2C=y
CONFIG_SYS_I2C_MXC=y
CONFIG_DM_MMC=y
# CONFIG_DM_MMC_OPS is not set
CONFIG_DM_ETH=y
CONFIG_PINCTRL=y
CONFIG_PINCTRL_IMX8M=y
CONFIG_DM_PMIC=y
CONFIG_DM_PMIC_PFUZE100=y
CONFIG_DM_REGULATOR=y
CONFIG_DM_REGULATOR_PFUZE100=y
CONFIG_DM_REGULATOR_FIXED=y
CONFIG_DM_REGULATOR_GPIO=y
CONFIG_DM_THERMAL=y
CONFIG_VIDEO=y
CONFIG_VIDEO_IMX8_HDMI=y
CONFIG_BOOTDELAY=-2
CONFIG_CMD_GPT=y
CONFIG_CMD_PART=y
CONFIG_EFI_PARTITION=y
CONFIG_PARTITION_TYPE_GUID=y
# CONFIG_STORE_MAC_IN_GLOBAL=y
```
